## firmware/main/Kconfig.projbuild
```kconfig
menu "RF Tomography"

config TOMO_WIFI_SSID
    string "Wi-Fi SSID"
    default "YOUR_2G_WIFI"

config TOMO_WIFI_PASSWORD
    string "Wi-Fi password"
    default ""

config TOMO_COLLECTOR_PORT
    int "Dashboard CSI UDP port (discovered automatically)"
    range 1 65535
    default 5005

endmenu
```
